## config/boards/arm/twoli/Kconfig.board
```kconfig
# Twoli board configuration

# Copyright (c) 2023 The ZMK Contributors
# SPDX-License-Identifier: MIT

config BOARD_TWOLI
	bool "Twoli"
	depends on SOC_NRF52840_QIAA
```

## config/boards/arm/twoli/Kconfig.defconfig
```kconfig
# Twoli board configuration

# Copyright (c) 2023 Noah Kiser
# SPDX-License-Identifier: Apache-2.0

config BOARD
	default "twoli" if BOARD_TWOLI

if BOARD_TWOLI

config BT_CTLR
	default BT

config ZMK_KEYBOARD_NAME
    default "Twoli"

if ZMK_DISPLAY

config ZMK_DISPLAY_BLANK_ON_IDLE
    bool "Blank display on idle"
    default y

choice LVGL_TXT_ENC
    default LVGL_TXT_ENC_UTF8

endchoice

choice ZMK_DISPLAY_STATUS_SCREEN
	default ZMK_DISPLAY_STATUS_SCREEN_CUSTOMDD

endchoice

config CUSTOM_WIDGET_MATRIX_STATUS
	bool "Use the custom matrix status widget"
	default y

config MATRIX_LAYOUT_ISO
	bool "ISO Enter on rows 0 and 1"
	default n

config MATRIX_LAYOUT_SHIFT
	bool "1.25 and 1.75 Shifts on row 2"
	default n

config MATRIX_LAYOUT_BOTTOM
	int "Bottom row layout: 1) 1-1-1 ; 2) 2.00-1 ; 3) 1.5-1.5"
	default 1

config CUSTOM_WIDGET_BATTERY_STATUS
	bool "Use a custom battery status widget"
	default y

# Uncomment below to enable batt percentage
config CUSTOM_WIDGET_BATTERY_STATUS_SHOW_PERCENTAGE
	bool "show batt percentage on custom batt widget"
	default y

config LVGL_FONT_MONTSERRAT_16
    default y

choice LVGL_THEME_DEFAULT_FONT_NORMAL
    default LVGL_THEME_DEFAULT_FONT_NORMAL_MONTSERRAT_16

endchoice

config LVGL_FONT_MONTSERRAT_12
    default y
    
choice LVGL_THEME_DEFAULT_FONT_SMALL
    default LVGL_THEME_DEFAULT_FONT_SMALL_MONTSERRAT_12

endchoice

config I2C
	default y

config SSD1306
	default y

config SSD1306_REVERSE_MODE
	default n

endif # ZMK_DISPLAY

endif # BOARD_TWOLI
```

## config/boards/arm/twoli/twoli_defconfig
```kconfig
# SPDX-License-Identifier: Apache-2.0

CONFIG_SOC_SERIES_NRF52X=y
CONFIG_SOC_NRF52840_QIAA=y
CONFIG_BOARD_TWOLI=y

# Enable MPU
CONFIG_ARM_MPU=y

# enable GPIO
CONFIG_GPIO=y

# disable uart driver
CONFIG_SERIAL=n
CONFIG_UART_CONSOLE=n
CONFIG_UART_INTERRUPT_DRIVEN=n

# enable console
CONFIG_CONSOLE=y

CONFIG_USE_DT_CODE_PARTITION=y
CONFIG_BUILD_OUTPUT_UF2=y

CONFIG_MPU_ALLOW_FLASH_WRITE=y
CONFIG_NVS=y
CONFIG_SETTINGS_NVS=y
CONFIG_FLASH=y
CONFIG_FLASH_PAGE_LAYOUT=y
CONFIG_FLASH_MAP=y

CONFIG_ZMK_USB=y
CONFIG_ZMK_BLE=y

#Uncomment below to enable NFC pins for gpio0 9 and gpio0 10
CONFIG_NFCT_PINS_AS_GPIOS=y

# Uncomment below to enable WPM status
CONFIG_ZMK_WIDGET_WPM_STATUS=n	

CONFIG_ZMK_WIDGET_BATTERY_STATUS=n

# Next 3 lines determing keyboard layout. "BOTTOM" choices are 3x1u, 2u+1u, and 2x1.5u
CONFIG_MATRIX_LAYOUT_ISO=0
CONFIG_MATRIX_LAYOUT_SHIFT=0
CONFIG_MATRIX_LAYOUT_BOTTOM=1

CONFIG_EC11=y
CONFIG_EC11_TRIGGER_GLOBAL_THREAD=y

CONFIG_ZMK_DISPLAY=y

CONFIG_I2C=y

CONFIG_SSD1306=y
CONFIG_SSD1306_REVERSE_MODE=y
CONFIG_LVGL_HOR_RES_MAX=128
CONFIG_LVGL_VER_RES_MAX=64
CONFIG_LVGL_VDB_SIZE=64
CONFIG_LVGL_DPI=148
CONFIG_LVGL_BITS_PER_PIXEL=1
CONFIG_LVGL_COLOR_DEPTH_1=y
CONFIG_LVGL_USE_THEME_MONO=y
CONFIG_LVGL_THEME_DEFAULT_COLOR_PRIMARY_RED=n
CONFIG_LVGL_THEME_DEFAULT_COLOR_SECONDARY_RED=n
CONFIG_LVGL_THEME_DEFAULT_COLOR_PRIMARY_BLACK=y
CONFIG_LVGL_THEME_DEFAULT_COLOR_SECONDARY_WHITE=y
```

## config/boards/sheilds/qazpad/Kconfig.defconfig
```kconfig
# Copyright (c) 2020 The ZMK Contributors
# SPDX-License-Identifier: MIT

if SHIELD_QAZPAD

config ZMK_KEYBOARD_NAME
    default "QAZpad"

endif
```

## config/boards/shields/asymptote/Kconfig.defconfig
```kconfig
# Copyright (c) 2020 The ZMK Contributors
# SPDX-License-Identifier: MIT

if SHIELD_ASYMPTOTE

config ZMK_KEYBOARD_NAME
    default "Asymptote"

endif
```

## config/boards/shields/hang10/Kconfig.defconfig
```kconfig
# Copyright (c) 2020 The ZMK Contributors
# SPDX-License-Identifier: MIT

if SHIELD_HANG10

config ZMK_KEYBOARD_NAME
    default "Hang10"

endif
```

## config/boards/shields/qazpad/Kconfig.shield
```kconfig
# Copyright (c) 2020 The ZMK Contributors
# SPDX-License-Identifier: MIT

config SHIELD_QAZPAD
   def_bool $(shields_list_contains,qazpad)
```

## config/boards/shields/smidge/Kconfig.defconfig
```kconfig
# Copyright (c) 2020 The ZMK Contributors
# SPDX-License-Identifier: MIT

if SHIELD_SMIDGE

config ZMK_KEYBOARD_NAME
    default "Smidge"

endif
```

## config/boards/shields/smidge/Kconfig.shield
```kconfig
# Copyright (c) 2020 The ZMK Contributors
# SPDX-License-Identifier: MIT

config SHIELD_SMIDGE
   def_bool $(shields_list_contains,smidge)
```

## config/boards/shields/tof/Kconfig.defconfig
```kconfig
# Copyright (c) 2020 The ZMK Contributors
# SPDX-License-Identifier: MIT

if SHIELD_TOF

config ZMK_KEYBOARD_NAME
    default "The Other 40%"

endif
```

## config/boards/shields/tof/Kconfig.shield
```kconfig
# Copyright (c) 2020 The ZMK Contributors
# SPDX-License-Identifier: MIT

config SHIELD_ASYMPTOTE
   def_bool $(shields_list_contains,asymptote)
```

## config/boards/shields/twister/Kconfig.defconfig
```kconfig
# Copyright (c) 2020 The ZMK Contributors
# SPDX-License-Identifier: MIT

if SHIELD_TWISTER

config ZMK_KEYBOARD_NAME
    default "Twister"

endif
```

## config/boards/shields/twoli/Kconfig.defconfig
```kconfig
if SHIELD_TWOLI

config ZMK_KEYBOARD_NAME
    default "Twoli"

if ZMK_DISPLAY

config I2C
	default y

config SSD1306
	default y

config SSD1306_REVERSE_MODE
	default y

endif # ZMK_DISPLAY

if LVGL


endif # LVGL

endif # SHIELD_TWOLI
```

## config/west.yml
```yaml
manifest:
  remotes:
    - name: xqinx
      url-base: https://github.com/xqinx
  projects:
    - name: zmk
      remote: xqinx
      revision: thb
      import: app/west.yml
  self:
    path: config
```
